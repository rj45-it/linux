## Documentation/devicetree/bindings/media/i2c/sony,imx682.yaml
```yaml
# SPDX-License-Identifier: (GPL-2.0-only OR BSD-2-Clause)
%YAML 1.2
---
$id: http://devicetree.org/schemas/media/i2c/sony,imx682.yaml#
$schema: http://devicetree.org/meta-schemas/core.yaml#

title: Sony IMX682 64 Mpixel CMOS Digital Image Sensor

maintainers:
  - linux@example.com

description:
  IMX682 is a 64 Mega-pixel CMOS image sensor with a square pixel array of
  size 9248 x 6936. It is programmable through I2C. Image data is sent
  through MIPI CSI-2 (4 lanes).

properties:
  compatible:
    const: sony,imx682

  reg:
    maxItems: 1

  clocks:
    maxItems: 1

  reset-gpios:
    maxItems: 1

  vana-supply:
    description: Analog voltage supply (2.8 V)

  vdig-supply:
    description: Digital voltage supply (1.0–1.1 V)

  vio-supply:
    description: I/O voltage supply (1.8 V)

  port:
    $ref: /schemas/graph.yaml#/$defs/port-base
    additionalProperties: false

    properties:
      endpoint:
        $ref: /schemas/media/video-interfaces.yaml#
        unevaluatedProperties: false

        properties:
          data-lanes:
            items:
              - const: 1
              - const: 2
              - const: 3
              - const: 4

          link-frequencies: true

        required:
          - data-lanes
          - link-frequencies

required:
  - compatible
  - reg
  - clocks
  - vana-supply
  - vdig-supply
  - vio-supply
  - port

additionalProperties: false

examples:
  - |
    i2c {
        #address-cells = <1>;
        #size-cells = <0>;

        camera@1a {
            compatible = "sony,imx682";
            reg = <0x1a>;
            clocks = <&camcc 65>;

            vio-supply  = <&s2mpb03_l3>;
            vana-supply = <&s2mpb03_l5>;
            vdig-supply = <&s2mpb03_l2>;

            reset-gpios = <&tlmm 30 GPIO_ACTIVE_HIGH>;

            port {
                endpoint {
                    remote-endpoint = <&csiphy0_ep>;
                    data-lanes = <1 2 3 4>;
                    link-frequencies = /bits/ 64 <1708800000>;
                };
            };
        };
    };
```
